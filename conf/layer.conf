## conf/layer.conf
```bitbake
# We have a conf and classes directory, append to BBPATH
BBPATH .= ":${LAYERDIR}"

# We have a recipes directory, add to BBFILES
BBFILES += "${LAYERDIR}/recipes*/*/*.bb ${LAYERDIR}/recipes*/*/*.bbappend ${LAYERDIR}/images/*.bb"

BBFILE_COLLECTIONS += "meta-i2c-devices"
BBFILE_PATTERN_meta-i2c-devices := "^${LAYERDIR}/recipes-i2c-devices/*"
BBFILE_PRIORITY_meta-i2c-devices = "16"

LAYERSERIES_COMPAT_meta-i2c-devices = "warrior"
```
